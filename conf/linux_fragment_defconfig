## defconfig
```kconfig
BR2_arm=y
BR2_cortex_a7=y
BR2_ARM_FPU_NEON_VFPV4=y
BR2_DL_DIR="$(BR2_EXTERNAL_BUILDROOT_SUBMODULE_PATH)/dl"
BR2_PACKAGE_OVERRIDE_FILE="$(BR2_EXTERNAL_BUILDROOT_SUBMODULE_PATH)/local.mk"
BR2_GLOBAL_PATCH_DIR="$(BR2_EXTERNAL_BUILDROOT_SUBMODULE_PATH)/patch"
BR2_TOOLCHAIN_EXTERNAL=y
BR2_TOOLCHAIN_EXTERNAL_CUSTOM=y
BR2_TOOLCHAIN_EXTERNAL_PATH="$(BR2_EXTERNAL_BUILDROOT_SUBMODULE_PATH)/toolchain/output/host/usr"
BR2_TOOLCHAIN_EXTERNAL_GCC_6=y
BR2_TOOLCHAIN_EXTERNAL_HEADERS_4_9=y
BR2_TOOLCHAIN_EXTERNAL_CUSTOM_GLIBC=y
BR2_TOOLCHAIN_EXTERNAL_CXX=y
BR2_TOOLCHAIN_EXTERNAL_GDB_SERVER_COPY=y
BR2_TOOLCHAIN_GLIBC_GCONV_LIBS_COPY=y
BR2_TARGET_GENERIC_HOSTNAME="raspki"
BR2_TARGET_GENERIC_GETTY_PORT="ttyAMA0"
BR2_ROOTFS_OVERLAY="$(BR2_EXTERNAL_BUILDROOT_SUBMODULE_PATH)/overlay"
BR2_ROOTFS_POST_BUILD_SCRIPT="board/raspberrypi2/post-build.sh"
BR2_LINUX_KERNEL=y
BR2_LINUX_KERNEL_CUSTOM_GIT=y
BR2_LINUX_KERNEL_CUSTOM_REPO_URL="https://github.com/raspberrypi/linux.git"
BR2_LINUX_KERNEL_CUSTOM_REPO_VERSION="5e4ee836560d4c0371e109bf469e1ad808ae7a44"
BR2_LINUX_KERNEL_DEFCONFIG="bcm2709"
BR2_LINUX_KERNEL_CONFIG_FRAGMENT_FILES="$(BR2_EXTERNAL_BUILDROOT_SUBMODULE_PATH)/conf/linux_fragment_defconfig"
BR2_LINUX_KERNEL_DTS_SUPPORT=y
BR2_LINUX_KERNEL_INTREE_DTS_NAME="bcm2709-rpi-2-b"
BR2_PACKAGE_DIEHARDER=y
BR2_PACKAGE_E2FSPROGS=y
BR2_PACKAGE_E2FSPROGS_RESIZE2FS=y
BR2_PACKAGE_RPI_FIRMWARE=y
BR2_PACKAGE_CRYPTSETUP=y
BR2_PACKAGE_PARTED=y
BR2_PACKAGE_RNG_TOOLS=y
BR2_PACKAGE_OPENSSL_ENGINES=y
BR2_PACKAGE_HAVEGED=y
BR2_PACKAGE_OPENSSH=y
BR2_PACKAGE_UTIL_LINUX_BINARIES=y
BR2_TARGET_ROOTFS_CPIO=y
BR2_TARGET_ROOTFS_CPIO_GZIP=y
BR2_PACKAGE_HOST_DOSFSTOOLS=y
BR2_PACKAGE_HOST_GENIMAGE=y
BR2_PACKAGE_HOST_MTOOLS=y
BR2_PACKAGE_EASY_RSA=y
```

## package/dieharder/Config.in
```kconfig
config BR2_PACKAGE_DIEHARDER
	bool "dieharder"
	help
	  dieharder is a fairly involved random number/uniform deviate generator
	  tester. It is thus suitable for use in testing both software RNG's and
	  hardware RNG's.

	  http://www.phy.duke.edu/~rgb/General/dieharder.php
```

## package/easy-rsa/Config.in
```kconfig
config BR2_PACKAGE_EASY_RSA
	bool "easy-rsa"
	select BR2_PACKAGE_OPENSSL # runtime
	select BR2_PACKAGE_OPENSSL_BIN # runtime
	help
	  Simple shell based CA utility
	  This package eases the creation of certificates, for example
	  for openvpn clients.

	  This was formerly part of the openvpn package.

	  easy-rsa is a wrapper script around OpenSSL binaries.

	  https://github.com/OpenVPN/easy-rsa
config BR2_PACKAGE_EASY_RSA_RELEASE
	bool "Build easy-rsa from a release"
	depends on BR2_PACKAGE_EASY_RSA
	default y
	help
	  Build from last release, else build from git master.
```

## toolchain/defconfig
```kconfig
BR2_arm=y
BR2_cortex_a7=y
BR2_ARM_FPU_NEON_VFPV4=y
BR2_DL_DIR="$(BR2_EXTERNAL_BUILDROOT_SUBMODULE_PATH)/dl"
BR2_PACKAGE_OVERRIDE_FILE="$(BR2_EXTERNAL_BUILDROOT_SUBMODULE_PATH)/local.mk"
BR2_GLOBAL_PATCH_DIR="$(BR2_EXTERNAL_BUILDROOT_SUBMODULE_PATH)/patch"
BR2_TOOLCHAIN_BUILDROOT_GLIBC=y
BR2_KERNEL_HEADERS_4_9=y
BR2_GLIBC_VERSION_2_25=y
BR2_BINUTILS_VERSION_2_28_X=y
BR2_GCC_VERSION_6_X=y
BR2_TOOLCHAIN_BUILDROOT_CXX=y
BR2_PACKAGE_HOST_GDB=y
BR2_PACKAGE_HOST_GDB_TUI=y
BR2_PACKAGE_HOST_GDB_PYTHON=y
BR2_PACKAGE_HOST_GDB_SIM=y
BR2_GDB_VERSION_7_12=y
BR2_TOOLCHAIN_GLIBC_GCONV_LIBS_COPY=y
BR2_INIT_NONE=y
# BR2_TARGET_ENABLE_ROOT_LOGIN is not set
BR2_SYSTEM_BIN_SH_NONE=y
# BR2_TARGET_GENERIC_GETTY is not set
# BR2_TARGET_GENERIC_REMOUNT_ROOTFS_RW is not set
BR2_ROOTFS_OVERLAY="$(BR2_EXTERNAL_BUILDROOT_SUBMODULE_PATH)/overlay"
# BR2_PACKAGE_BUSYBOX is not set
BR2_PACKAGE_GDB=y
BR2_PACKAGE_GDB_SERVER=y
BR2_PACKAGE_GDB_DEBUGGER=y
BR2_PACKAGE_GDB_TUI=y
# BR2_TARGET_ROOTFS_TAR is not set
```
